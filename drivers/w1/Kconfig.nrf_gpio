## drivers/w1/Kconfig.nrf_gpio
```kconfig
# Configuration options for the nrf GPIO 1-Wire Master driver

# Copyright (c) 2026, Nordic Semiconductor ASA 
# SPDX-License-Identifier: Apache-2.0

config W1_NRF_GPIO
	bool "1-wire GPIO"
	default y
	depends on DT_HAS_W1_NRF_GPIO_ENABLED
	help
	  This option enables the nrf GPIO 1-Wire master driver.

	  The bus reset, and bit read and write operations are executed
	  via byte read and write operations on top of the nrf
	  GPIO driver interface.

if W1_NRF_GPIO

config W1_NRF_GPIO_TIME_CRITICAL
	bool "Force time critical operations"
	default y
	help
	  This option forces the 1-Wire GPIO driver to use time critical
	  operations for bus reset, and bit read and write operations.
	  Time critical communications operations are not interrupted while
	  being generated.

endif # W1_NRF_GPIO
```

## drivers/w1/Kconfig.nrf_serial
```kconfig
# Configuration options for the NRF serial 1-Wire Master driver

# Copyright (c) 2026, Nordic Semiconductor ASA
# SPDX-License-Identifier: Apache-2.0

config W1_NRF_SERIAL
	bool "1-wire Serial"
	select SERIAL
	default y
	depends on DT_HAS_NRF_W1_SERIAL_ENABLED
	select UART_USE_RUNTIME_CONFIGURE
    select NRFX_UARTE
	help
	  This option enables the NRF serial 1-Wire master driver.

	  The bus reset, and bit read and write operations are executed
	  via bytes read and write operations on top of the NRF
	  serial driver interface.

if W1_NRF_SERIAL

config W1_NRF_SERIAL_TIME_CRITICAL
	bool "Use time-critical polling mode"
	default y
	help
	  Enable blocking transfers and polling for completion to minimize
	  communication latency. Disabling this option uses UARTE interrupts
	  and semaphores, allowing the CPU to sleep or execute other work
	  while a transfer is in progress.

config NRF_W1_SERIAL_BIT_TIMEOUT
	int "Bit read timeout in us"
	default 380
	help
	  The bit read timeout specifies how long the driver tries to read the
	  uart byte (1-wire standard speed data bit).
	  For serial drivers where poll_out does not block until the transfer is
	  complete, it must at least be greater than 87us (10bits / 115.2 kBd).

endif # W1_NRF_SERIAL
```
